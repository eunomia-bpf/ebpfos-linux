## kernel/ebpfos/Kconfig
```kconfig
# SPDX-License-Identifier: GPL-2.0-only
config EBPFOS
	bool "eBPFOS transactional component graph"
	depends on BPF_SYSCALL && BPF_JIT
	select DEBUG_KERNEL
	select KALLSYMS
	select KALLSYMS_ALL
	default n
	help
	  Build the eBPFOS component nucleus and transactional package admission.
	  Keep data symbols, including local and per-CPU allocations, available
	  for native-symbol relocations at runtime.

config EBPFOS_BUILD
	bool
	default y if EBPFOS

config EBPFOS_ENTRY_LINK
 bool "Typed multi-target BPF entry links"
 depends on EBPFOS && X86_64
 depends on !CFI
 select INSTRUCTION_DECODER
 default y
 help
   Replace reserved or inactive ftrace entries and module-local callers
   through BPF program and link objects using one text transaction.
   Native programs are source-built staged exceptions requiring CAP_SYS_ADMIN.

config EBPFOS_PLT
 bool "Prototype task-selected direct entry stubs"
 depends on EBPFOS_ENTRY_LINK
 select TASKS_RCU
 default n
 help
   Experimental direct-branch selection at multi-version function entries.
   Resolve existing binding rules with task work and keep upstream syscall
   dispatch. No task syscall table or private kernel page tables are used.

config EBPFOS_PTVIEW
 bool "Prototype per-mm kernel view mappings"
 depends on EBPFOS_ENTRY_LINK && X86_64 && !X86_5LEVEL && !EBPFOS_PLT
 default n
 help
   Opt-in four-level, non-PCID prototype. Private copies cover changed
   entry instructions and binding-data pages.
   Rule resolution retains the selected mappings at the task boundary.

config EBPFOS_AUTOBIND
 bool "Automatic rule-selected kernel mappings"
 depends on EBPFOS_PTVIEW
 default y
 help
   Resolve existing L6 rules at the task boundary and map immutable callback
   data at its original addresses. Syscall roots keep their existing table.
   The owner-boundary handoff remains an optional alternative
   when this option is disabled. Paging restrictions are those of PTVIEW.
```
